## arch/arm/configs/msm8226_sec_eng_defconfig
```kconfig
#msm8226 eng defconfig

CONFIG_MSM_L2_ERP_PRINT_ACCESS_ERRORS=y
# CONFIG_MSM_L2_ERP_PORT_PANIC is not set
# CONFIG_MSM_L2_ERP_1BIT_PANIC is not set
CONFIG_MSM_CACHE_DUMP=y
CONFIG_MSM_CACHE_DUMP_ON_PANIC=y
CONFIG_MSM_IOMMU_PMON=y
CONFIG_LOCKUP_DETECTOR=y
CONFIG_UID_STAT=y
# CONFIG_DETECT_HUNG_TASK is not set
# CONFIG_SYSRQ_SCHED_DEBUG is not set
CONFIG_SCHEDSTATS=y
CONFIG_DEBUG_KMEMLEAK=y
CONFIG_DEBUG_KMEMLEAK_DEFAULT_OFF=y
CONFIG_DEBUG_SPINLOCK=y
CONFIG_DEBUG_MUTEXES=y
CONFIG_DEBUG_ATOMIC_SLEEP=y
CONFIG_DEBUG_STACK_USAGE=y
CONFIG_DEBUG_LIST=y
CONFIG_FAULT_INJECTION=y
CONFIG_FAIL_PAGE_ALLOC=y
CONFIG_FAULT_INJECTION_DEBUG_FS=y
CONFIG_FAULT_INJECTION_STACKTRACE_FILTER=y
CONFIG_DEBUG_PAGEALLOC=y
CONFIG_ENABLE_DEFAULT_TRACERS=y
CONFIG_PANIC_ON_DATA_CORRUPTION=y
CONFIG_DEBUG_LL=y
CONFIG_EARLY_PRINTK=y
CONFIG_CPU_FREQ_SWITCH_PROFILER=y

CONFIG_SEC_GPIO_DVS=y
#CONFIG_SEC_FILE_LEAK_DEBUG=y
CONFIG_ES325_UART_WORKAROUND_ENG_ONLY=y
CONFIG_SYSFS=y
CONFIG_BLOCK=y
CONFIG_TRACING_SUPPORT=y
CONFIG_FTRACE=y
CONFIG_BLK_DEV_IO_TRACE=y

#EARJACK SYSFS
CONFIG_EARJACK_ADC_SYSFS=y

# RTB
CONFIG_MSM_RTB=y
CONFIG_MSM_RTB_SEPARATE_CPUS=y

# ETM related config flags
CONFIG_CORESIGHT=y
CONFIG_CORESIGHT_FUSE=y
CONFIG_CORESIGHT_TMC=y
CONFIG_CORESIGHT_TPIU=y
CONFIG_CORESIGHT_FUNNEL=y
CONFIG_CORESIGHT_REPLICATOR=y
CONFIG_CORESIGHT_STM=y
CONFIG_CORESIGHT_HWEVENT=y
CONFIG_CORESIGHT_ETM=y
CONFIG_CORESIGHT_AUDIO_ETM=y
CONFIG_CORESIGHT_MODEM_ETM=y
CONFIG_CORESIGHT_WCN_ETM=y
CONFIG_CORESIGHT_RPM_ETM=y
CONFIG_CORESIGHT_ETM_PCSAVE_DEFAULT_ENABLE=n
CONFIG_CORESIGHT_EVENT=m

# List/Tree corruption / Memory corruption related config flags
#CONFIG_SEC_DEBUG_LMK_MEMINFO=y
#CONFIG_SEC_DEBUG_ZERO_FD_CLOSE=y

#CONFIG_SEC_SSR_DEBUG_LEVEL_CHK=y
#CONFIG_SEC_DEBUG_DOUBLE_FREE is not set
CONFIG_PAGE_GUARD=y
CONFIG_MSM_CACHE_DUMP=y
CONFIG_HAVE_DMA_API_DEBUG=y
CONFIG_MSM_SMD_DEBUG=y
CONFIG_DEBUG_FS=y
CONFIG_SLUB_DEBUG=y
#CONFIG_SLUB_DEBUG_ON=y
CONFIG_COMPACTION=y

CONFIG_PAGE_POISON=y

CONFIG_IKCONFIG=y
CONFIG_IKCONFIG_PROC=y

CONFIG_SAMSUNG_BATTERY_ENG_TEST=y

# CONFIG_SEC_RESTRICT_ROOTING is not set
# CONFIG_SEC_RESTRICT_SETUID is not set
# CONFIG_SEC_RESTRICT_FORK is not set
# CONFIG_SEC_RESTRICT_ROOTING_LOG is not set
#LCIA test fail in factory mode
CONFIG_DUMP_UART_PACKET_DISABLE=y
```

## arch/arm/configs/msm8226_sec_userdebug_defconfig
```kconfig
#enable /proc/config.gz kernel build option
CONFIG_IKCONFIG=y
CONFIG_IKCONFIG_PROC=y
```

## arch/arm/configs/msm8974_sec_eng_defconfig
```kconfig
##eng


CONFIG_MSM_CACHE_DUMP=y
CONFIG_MSM_CACHE_DUMP_ON_PANIC=y

CONFIG_MSM_XPU_ERR_FATAL=y

# CONFIG_CFG80211_INTERNAL_REGDB is not set

CONFIG_MSM_IOMMU_PMON=y

CONFIG_CORESIGHT=y
CONFIG_CORESIGHT_FUSE=y
CONFIG_CORESIGHT_TMC=y
CONFIG_CORESIGHT_TPIU=y
CONFIG_CORESIGHT_FUNNEL=y
CONFIG_CORESIGHT_REPLICATOR=y
CONFIG_CORESIGHT_STM=y
CONFIG_CORESIGHT_HWEVENT=y
CONFIG_CORESIGHT_ETM=y
CONFIG_CORESIGHT_ETM_DEFAULT_ENABLE=y
CONFIG_CORESIGHT_ETM_PCSAVE_DEFAULT_ENABLE=y
CONFIG_CORESIGHT_EVENT=y

CONFIG_LOCKUP_DETECTOR=y
# CONFIG_DETECT_HUNG_TASK is not set

CONFIG_DEBUG_KMEMLEAK=y
CONFIG_DEBUG_KMEMLEAK_DEFAULT_OFF=y
CONFIG_DEBUG_SPINLOCK=y
CONFIG_DEBUG_MUTEXES=y
CONFIG_DEBUG_ATOMIC_SLEEP=y
CONFIG_DEBUG_STACK_USAGE=y

CONFIG_FAULT_INJECTION=y
CONFIG_FAIL_PAGE_ALLOC=y
CONFIG_FAULT_INJECTION_DEBUG_FS=y
CONFIG_FAULT_INJECTION_STACKTRACE_FILTER=y
# CONFIG_DEBUG_PAGEALLOC is not set
CONFIG_CPU_FREQ_SWITCH_PROFILER=y

CONFIG_PANIC_ON_DATA_CORRUPTION=y

CONFIG_DEBUG_LL=y
CONFIG_EARLY_PRINTK=y

#enable DVS for iora test
CONFIG_SEC_GPIO_DVS=y

# CONFIG_SEC_RESTRICT_ROOTING is not set
# CONFIG_SEC_RESTRICT_SETUID is not set
# CONFIG_SEC_RESTRICT_FORK is not set
# CONFIG_SEC_RESTRICT_ROOTING_LOG is not set

#enable block trace
CONFIG_BLOCK=y
CONFIG_BLK_DEV_IO_TRACE=y

CONFIG_SEC_FILE_LEAK_DEBUG=y
CONFIG_MSM_BUSPM_DEV=y

CONFIG_SAMSUNG_BATTERY_ENG_TEST=y

#enable systrace
CONFIG_ENABLE_DEFAULT_TRACERS=y
CONFIG_SEC_NET_FILTER=y

#enable memory device driver(/dev/mem)
CONFIG_DEVMEM=y
```

## arch/arm/configs/msm8974_sec_userdebug_defconfig
```kconfig
# Overriding the rooting prevention feature as disable on ENG build
# CONFIG_SEC_RESTRICT_ROOTING is not set
# CONFIG_SEC_RESTRICT_SETUID is not set
# CONFIG_SEC_RESTRICT_FORK is not set
# CONFIG_SEC_RESTRICT_ROOTING_LOG is not set
#CONFIG_IKCONFIG=y
#CONFIG_IKCONFIG_PROC=y
CONFIG_ENABLE_DEFAULT_TRACERS=y
```

## arch/arm/configs/tima8226_defconfig
```kconfig
# Note of using this defconfig:
# Before adding anything here, make sure it has an entry in
# arch/arm/mach-msm/Kconfig with appropriate dependency spec and 
# help text.
# https://www.kernel.org/doc/Documentation/kbuild/kconfig-language.txt
#
# Contact: Jitesh Shah <j1.shah@sta.samsung.com> for more info
#
# LKMAUTH defines
# CONFIG_TIMA_LKMAUTH is not set
#CONFIG_TIMA_LKMAUTH_CODE_PROT=n

# Other TIMA bits. Log and Uevent. Note that apart from LKM
# these might also be dependent on PKM, Attestation and Keystore.
# So its best to always keep them turned on even though LKM is 
# disabled.
CONFIG_TIMA=y
CONFIG_TIMA_UEVENT=y
CONFIG_TIMA_LOG=y
#CONFIG_TIMA_TEST_INFRA=m
```

## drivers/input/touchscreen/cyttsp4/Kconfig
```kconfig
# Cypress Touchscreen driver configuration
#

config TOUCHSCREEN_CYTTSP4
	tristate "CYPRESS touchscreen driver"
	depends on I2C
```

## drivers/irda/Kconfig
```kconfig
#
# IR_LED
#
menu "IRDA devices"

config IR_REMOCON_MC96FR116
	bool "Micom MC96FR116 ABOV based IR LED driver"
	depends on I2C
	default n
	help
	  Say Y here to enable the I2C based IRDA for MC96FR116C chip.

endmenu
```

## drivers/motor/Kconfig
```kconfig
#
# Immersion TouchSense Player driver configuration
#
menuconfig VIBETONZ
	tristate "Vibetonz"
	default n
	help
	Say Y to enable Vibetonz support.
	-------------
	-------------
	-------------

config TACTILE_ASSIST
	tristate "Auto Haptic"
	default n
	depends on VIBETONZ

config MOTOR_DRV_MAX77803
	tristate "Maxim MAX77803 motor"
	default n

	depends on MFD_MAX77803

config MOTOR_DRV_MAX77804K
	tristate "Maxim MAX77804K motor"
	default n

	depends on MFD_MAX77804K

config MOTOR_DRV_MAX77828
	tristate "Maxim MAX77828 motor"
	default n
	depends on MFD_MAX77828

config MOTOR_DRV_ISA1400
	tristate "ISA1400 motor"
	default n
	depends on I2C
	help
	  Say Y to enalbe the ISA1400 IC.

config MOTOR_DRV_DRV2603
	tristate "DRV2603 motor"
	default n
	help
	  Say Y to enalbe the DRV2603 IC.

#
# Immersion TouchSense Player driver configuration
#
menuconfig MOTOR_DRV_TSP5000
        tristate "MOTOR_DRV_TSP5000"
        default n
        help
          Say Y to enable MOTOR_DRV_TSP5000 support.

#
# vibrator controlled by PMIC regualtor configuration
#
menuconfig MSM_VIBRATOR
	tristate "MSM_VIBRATOR"
	default n
	help
	Say Y to enable MSM_VIBRATOR support.

config CONFIG_HAPTIC_ISA1200
        tristate "ISA1200 motor"
        default n
        depends on I2C
        help
          Say Y to enable the ISA1200 IC. 
```

## fs/scfs/Kconfig
```kconfig
config SCFS
	tristate "SCFS layer support (EXPERIMENTAL)"
	help
	  SCFS on the VFS layer.
	  See <file:Documentation/filesystems/scfs.txt> for more info.

config SYSTEM_COMPRESSED 
	tristate "Flag to check system partition state"
	help
	 Flag to check system partition state 
```
